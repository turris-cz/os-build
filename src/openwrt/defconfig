## src/openwrt/defconfig
```kconfig
CONFIG_TARGET_ipq95xx=y
CONFIG_TARGET_ipq95xx_generic=y
CONFIG_TARGET_ipq95xx_generic_QSDK_Open=y
CONFIG_TARGET_DEVICE_ipq95xx_generic_DEVICE_cznic_turris-omnia-ng=y
CONFIG_DEVEL=y
CONFIG_TOOLCHAINOPTS=y
CONFIG_BUSYBOX_CUSTOM=y
CONFIG_BTRFS_PROGS_ZSTD=y
CONFIG_BUSYBOX_CONFIG_FEATURE_GETOPT_LONG=y
CONFIG_BUSYBOX_CONFIG_FEATURE_SEAMLESS_XZ=y
CONFIG_BUSYBOX_CONFIG_FEATURE_TAR_LONG_OPTIONS=y
CONFIG_BUSYBOX_CONFIG_GETOPT=y
CONFIG_BUSYBOX_CONFIG_MOUNTPOINT=y
CONFIG_BUSYBOX_CONFIG_PIE=y
CONFIG_BUSYBOX_CONFIG_UNXZ=y
CONFIG_BUSYBOX_CONFIG_XZ=y
CONFIG_BUSYBOX_DEFAULT_PIE=y
CONFIG_COLLECT_KERNEL_DEBUG=y
CONFIG_GIT_MIRROR="https://git.codelinaro.org/clo/qsdk/"
CONFIG_IMAGEOPT=y
CONFIG_IPERF_ENABLE_MULTICAST=y
CONFIG_KERNEL_ARM_PMU=y
CONFIG_KERNEL_ARM_PMUV3=y
CONFIG_KERNEL_BTRFS_FS=y
# CONFIG_KERNEL_CC_STACKPROTECTOR_REGULAR is not set
CONFIG_KERNEL_CC_STACKPROTECTOR_STRONG=y
CONFIG_KERNEL_CPU_FREQ_THERMAL=y
CONFIG_KERNEL_CPU_THERMAL=y
CONFIG_KERNEL_DEBUG_ATOMIC_SLEEP=y
CONFIG_KERNEL_DEBUG_GPIO=y
# CONFIG_KERNEL_DEBUG_INFO_REDUCED is not set
CONFIG_KERNEL_DEVMEM=y
CONFIG_KERNEL_DYNAMIC_DEBUG=y
CONFIG_KERNEL_HWMON=y
# CONFIG_KERNEL_KEYS is not set
CONFIG_KERNEL_PERF_EVENTS=y
CONFIG_KERNEL_STACKPROTECTOR_STRONG=y
# CONFIG_KERNEL_SWAP is not set
# CONFIG_KERNEL_WERROR is not set
CONFIG_LIBSSH2_OPENSSL=y
# CONFIG_LINUX_IS_FLATTENED_TREE is not set
CONFIG_LOCALMIRROR="https://sources.cdn.openwrt.org/"
CONFIG_MC_CHARSET=y
CONFIG_MC_EDITOR=y
CONFIG_MC_SUBSHELL=y
CONFIG_MC_VFS=y
CONFIG_MOLD=y
# CONFIG_PACKAGE_464xlat is not set
# CONFIG_PACKAGE_6rd is not set
CONFIG_PACKAGE_ATH_DEBUG=y
CONFIG_PACKAGE_alsa-lib=y
CONFIG_PACKAGE_alsa-ucm-conf=y
# CONFIG_PACKAGE_avahi-dbus-daemon is not set
CONFIG_PACKAGE_blkdiscard=y
CONFIG_PACKAGE_blkid=y
CONFIG_PACKAGE_btop=y
CONFIG_PACKAGE_btrfs-progs=y
# CONFIG_PACKAGE_dbus is not set
CONFIG_PACKAGE_dmesg=y
CONFIG_PACKAGE_dosfstools=y
# CONFIG_PACKAGE_ds-lite is not set
# CONFIG_PACKAGE_ethtool is not set
CONFIG_PACKAGE_ethtool-full=y
CONFIG_PACKAGE_fdisk=y
CONFIG_PACKAGE_flock=y
CONFIG_PACKAGE_glib2=y
# CONFIG_PACKAGE_hostapd-macsec is not set
CONFIG_PACKAGE_i2csfp=y
# CONFIG_PACKAGE_ip6tables-nft is not set
CONFIG_PACKAGE_iperf3=y
# CONFIG_PACKAGE_ipset is not set
# CONFIG_PACKAGE_iptables-mod-conntrack-extra is not set
# CONFIG_PACKAGE_iptables-mod-filter is not set
# CONFIG_PACKAGE_iptables-mod-ipopt is not set
# CONFIG_PACKAGE_iptables-mod-ipsec is not set
# CONFIG_PACKAGE_iptables-mod-nat-extra is not set
# CONFIG_PACKAGE_iptables-mod-physdev is not set
# CONFIG_PACKAGE_iptables-nft is not set
CONFIG_PACKAGE_iputils-ping=y
# CONFIG_PACKAGE_isc-dhcp-relay-ipv6 is not set
# CONFIG_PACKAGE_kmod-aqr-phy is not set
CONFIG_PACKAGE_kmod-crypto-blake2b=y
CONFIG_PACKAGE_kmod-crypto-xxhash=y
# CONFIG_PACKAGE_kmod-emesh-sp is not set
CONFIG_PACKAGE_kmod-fs-btrfs=y
# CONFIG_PACKAGE_kmod-fuse is not set
# CONFIG_PACKAGE_kmod-ifb is not set
CONFIG_PACKAGE_kmod-ikconfig=y
# CONFIG_PACKAGE_kmod-ip6tables is not set
# CONFIG_PACKAGE_kmod-ipt-conntrack-extra is not set
# CONFIG_PACKAGE_kmod-ipt-filter is not set
# CONFIG_PACKAGE_kmod-ipt-ipopt is not set
# CONFIG_PACKAGE_kmod-ipt-ipsec is not set
# CONFIG_PACKAGE_kmod-ipt-ipset is not set
# CONFIG_PACKAGE_kmod-ipt-nat is not set
# CONFIG_PACKAGE_kmod-ipt-nat-extra is not set
# CONFIG_PACKAGE_kmod-ipt-nat6 is not set
# CONFIG_PACKAGE_kmod-ipt-nathelper-rtsp is not set
# CONFIG_PACKAGE_kmod-ipt-physdev is not set
# CONFIG_PACKAGE_kmod-ipt-raw is not set
# CONFIG_PACKAGE_kmod-ipt-raw6 is not set
# CONFIG_PACKAGE_kmod-ipt-sctp is not set
# CONFIG_PACKAGE_kmod-l2tp-eth is not set
# CONFIG_PACKAGE_kmod-l2tp-ip is not set
CONFIG_PACKAGE_kmod-lib-lzo=y
CONFIG_PACKAGE_kmod-lib-raid6=y
CONFIG_PACKAGE_kmod-lib-xor=y
CONFIG_PACKAGE_kmod-lib-xxhash=y
CONFIG_PACKAGE_kmod-lib-zstd=y
# CONFIG_PACKAGE_kmod-macvlan is not set
# CONFIG_PACKAGE_kmod-mpls is not set
# CONFIG_PACKAGE_kmod-mppe is not set
# CONFIG_PACKAGE_kmod-nsh is not set
# CONFIG_PACKAGE_kmod-nss-udp-st-drv is not set
# CONFIG_PACKAGE_kmod-openvswitch is not set
# CONFIG_PACKAGE_kmod-qca-nss-dscpstats is not set
# CONFIG_PACKAGE_kmod-qca-nss-ecm-wifi-plugin is not set
# CONFIG_PACKAGE_kmod-qca-nss-eip-crypto is not set
# CONFIG_PACKAGE_kmod-qca-nss-fls is not set
# CONFIG_PACKAGE_kmod-qca-nss-fls-lite is not set
# CONFIG_PACKAGE_kmod-qca-nss-netfn-tcpst is not set
# CONFIG_PACKAGE_kmod-qca-nss-ppe-dsa-mgr is not set
# CONFIG_PACKAGE_kmod-qca-nss-ppe-mirror-test is not set
# CONFIG_PACKAGE_kmod-qca-ovsmgr is not set
# CONFIG_PACKAGE_kmod-qca8k is not set
# CONFIG_PACKAGE_kmod-sched-act-ipt is not set
# CONFIG_PACKAGE_kmod-sched-act-police is not set
# CONFIG_PACKAGE_kmod-sched-connmark is not set
# CONFIG_PACKAGE_kmod-sit is not set
CONFIG_PACKAGE_kmod-sound-core=y
CONFIG_PACKAGE_kmod-usb-net-rndis=y
CONFIG_PACKAGE_kmod-usb-serial=y
CONFIG_PACKAGE_kmod-usb-serial-option=y
CONFIG_PACKAGE_kmod-usb-serial-wwan=y
CONFIG_PACKAGE_kmod-veth=y
CONFIG_PACKAGE_libacl=y
# CONFIG_PACKAGE_libavahi-client is not set
# CONFIG_PACKAGE_libavahi-dbus-support is not set
# CONFIG_PACKAGE_libcurl is not set
# CONFIG_PACKAGE_libdaemon is not set
# CONFIG_PACKAGE_libdbus is not set
CONFIG_PACKAGE_libevdev=y
CONFIG_PACKAGE_libevent2-core=y
# CONFIG_PACKAGE_libexpat is not set
CONFIG_PACKAGE_libfdisk=y
CONFIG_PACKAGE_libffi=y
# CONFIG_PACKAGE_libgmp is not set
# CONFIG_PACKAGE_libgnutls is not set
# CONFIG_PACKAGE_libip4tc is not set
CONFIG_PACKAGE_libiperf3=y
# CONFIG_PACKAGE_libipset is not set
# CONFIG_PACKAGE_libiptext is not set
# CONFIG_PACKAGE_libiptext-nft is not set
# CONFIG_PACKAGE_libiptext6 is not set
CONFIG_PACKAGE_libkmod=y
CONFIG_PACKAGE_liblz4=y
CONFIG_PACKAGE_liblzo=y
CONFIG_PACKAGE_libmount=y
# CONFIG_PACKAGE_libnettle is not set
# CONFIG_PACKAGE_libnghttp2 is not set
# CONFIG_PACKAGE_libnl is not set
# CONFIG_PACKAGE_libnl-cli is not set
# CONFIG_PACKAGE_libnl-core is not set
# CONFIG_PACKAGE_libnl-genl is not set
# CONFIG_PACKAGE_libnl-nf is not set
# CONFIG_PACKAGE_libnl-ppe is not set
# CONFIG_PACKAGE_libnl-route is not set
# CONFIG_PACKAGE_libnl-tcpst is not set
CONFIG_PACKAGE_libnvme=y
CONFIG_PACKAGE_libpci=y
CONFIG_PACKAGE_libpcre2=y
# CONFIG_PACKAGE_libreadline is not set
CONFIG_PACKAGE_libssh2=y
# CONFIG_PACKAGE_libtasn1 is not set
# CONFIG_PACKAGE_libtirpc is not set
CONFIG_PACKAGE_libudev-zero=y
# CONFIG_PACKAGE_liburing is not set
CONFIG_PACKAGE_libusb-1.0=y
CONFIG_PACKAGE_libxxhash=y
CONFIG_PACKAGE_libzstd=y
CONFIG_PACKAGE_lsblk=y
# CONFIG_PACKAGE_luci-app-samba4 is not set
# CONFIG_PACKAGE_map is not set
CONFIG_PACKAGE_mc=y
CONFIG_PACKAGE_memtester=y
CONFIG_PACKAGE_mhz=y
CONFIG_PACKAGE_minicom=y
# CONFIG_PACKAGE_mwan3 is not set
# CONFIG_PACKAGE_nss-tcp-st-cli is not set
# CONFIG_PACKAGE_nss-udp-st is not set
# CONFIG_PACKAGE_ntfs-3g is not set
CONFIG_PACKAGE_nvme-cli=y
CONFIG_PACKAGE_omnia-ng-tools=y
CONFIG_PACKAGE_pciids=y
CONFIG_PACKAGE_pciutils=y
# CONFIG_PACKAGE_ppecfg is not set
# CONFIG_PACKAGE_ppp-mod-pppoe is not set
# CONFIG_PACKAGE_ppp-mod-pppol2tp is not set
# CONFIG_PACKAGE_ppp-mod-pptp is not set
# CONFIG_PACKAGE_qca-ssdk-shell is not set
# CONFIG_PACKAGE_resolveip is not set
# CONFIG_PACKAGE_rp-pppoe-common is not set
# CONFIG_PACKAGE_rp-pppoe-relay is not set
# CONFIG_PACKAGE_rp-pppoe-server is not set
# CONFIG_PACKAGE_rstp is not set
CONFIG_PACKAGE_rsync=y
# CONFIG_PACKAGE_samba4-libs is not set
# CONFIG_PACKAGE_samba4-server is not set
# CONFIG_PACKAGE_strongswan is not set
# CONFIG_PACKAGE_tayga is not set
# CONFIG_PACKAGE_tc-full is not set
CONFIG_PACKAGE_tc-tiny=y
CONFIG_PACKAGE_tmux=y
CONFIG_PACKAGE_turris-omnia-ng-wifi-firmware=y
# CONFIG_PACKAGE_uboot-ipq9574-mmc is not set
# CONFIG_PACKAGE_uboot-ipq9574-nand is not set
# CONFIG_PACKAGE_uboot-ipq9574-norplusmmc is not set
# CONFIG_PACKAGE_uboot-ipq9574-norplusnand is not set
CONFIG_PACKAGE_unzip=y
CONFIG_PACKAGE_usbids=y
CONFIG_PACKAGE_usbutils=y
# CONFIG_PACKAGE_vxlan is not set
CONFIG_PACKAGE_wget-ssl=y
# CONFIG_PACKAGE_wpa-supplicant-macsec is not set
# CONFIG_PACKAGE_wsdd2 is not set
# CONFIG_PACKAGE_xl2tpd is not set
# CONFIG_PACKAGE_xtables-nft is not set
CONFIG_PACKAGE_zstd=y
CONFIG_PKG_ASLR_PIE_ALL=y
# CONFIG_PKG_ASLR_PIE_REGULAR is not set
# CONFIG_PKG_CC_STACKPROTECTOR_REGULAR is not set
CONFIG_PKG_CC_STACKPROTECTOR_STRONG=y
# CONFIG_PKG_FORTIFY_SOURCE_1 is not set
CONFIG_PKG_FORTIFY_SOURCE_2=y
CONFIG_PREINITOPT=y
# CONFIG_QCA_NSS_ECM_EXAMPLES_PCC is not set
CONFIG_RSYNC_acl=y
CONFIG_RSYNC_lz4=y
CONFIG_RSYNC_xattr=y
CONFIG_RSYNC_xxhash=y
CONFIG_RSYNC_zstd=y
CONFIG_TARGET_ALL_PROFILES=y
CONFIG_TARGET_INITRAMFS_COMPRESSION_LZMA=y
# CONFIG_TARGET_INITRAMFS_COMPRESSION_NONE is not set
CONFIG_TARGET_PREINIT_TIMEOUT=0
CONFIG_WPA_MSG_MIN_PRIORITY=1
CONFIG_ZSTD_OPTIMIZE_O3=y
CONFIG_MOLD=y
CONFIG_PACKAGE_attr=y
CONFIG_PACKAGE_kmod-br-netfilter=y
CONFIG_PACKAGE_kmod-crypto-arc4=y
CONFIG_PACKAGE_kmod-crypto-ecb=y
CONFIG_PACKAGE_kmod-crypto-user=y
CONFIG_PACKAGE_kmod-nf-conncount=y
CONFIG_PACKAGE_kmod-nf-ipt6=y
CONFIG_PACKAGE_kmod-nf-nat6=y
CONFIG_PACKAGE_kmod-nft-compat=y
CONFIG_PACKAGE_kmod-nft-connlimit=y
CONFIG_PACKAGE_kmod-qca-nss-flowmgr=y
CONFIG_PACKAGE_kmod-qca-nss-ppe-netlink=y
CONFIG_PACKAGE_kmod-tun=y
CONFIG_PACKAGE_libcap=y
# CONFIG_PACKAGE_libcap-bin is not set
# CONFIG_USE_MOLD is not set
```
